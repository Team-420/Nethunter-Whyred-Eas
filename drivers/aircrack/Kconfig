## drivers/aircrack/Kconfig
```kconfig
comment "Aditional WiFi adapter drivers for NetHunter by @S133PY"

source "drivers/aircrack/rtl8188eus/Kconfig"

source "drivers/aircrack/rtl8188fu/Kconfig"

source "drivers/aircrack/rtl8812au/Kconfig"

source "drivers/aircrack/rtl8192eu/Kconfig"

source "drivers/aircrack/rtl8814au/Kconfig"
```
